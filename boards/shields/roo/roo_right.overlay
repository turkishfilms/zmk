#include "roo.dtsi" // The shared dtsi file is included in the overlay

//L:21,E:15,O:20,I:14,Y:5,H:19,',':4,n:16,';':18,u:10,'.':6,'/':7,<Bkps>:9,mo1:8
//L:21,H:10,N:5,',':18,o:16,';':15,U:14,y:20,I:19,e:4,'.':6,'/':7
//lhn,o;uyie./
//lh<<lhn,,<..><lhn,o;uyie.
// lhn,o;uyie./
//
//
//GOAL::: luy;neioh,./
// 21,10,5,18,16,15,14,20,19,4,6,7,9,8
//leoiyh,n;u./
//lioey,hnu;./
//lhn,o;uyie./
//caude 21, 14, 20, 15, 16, 19, 4, 18, 10, 5, 6, 7, 9, 8
// claude2 21, 14, 20, 15, 5, 4, 19, 16, 10, 18, 6, 7, 9, 8
//claude3 21, 10, 5, 18, 16, 15, 14, 20, 19, 4, 6, 7, 9, 8
//luy;neio;h,./
// Label of the kscan node in the dtsi
&kscan0 {
	input-gpios
            = <&pro_micro 21 (GPIO_ACTIVE_LOW | GPIO_PULL_UP)>
            , <&pro_micro 19 (GPIO_ACTIVE_LOW | GPIO_PULL_UP)>
            , <&pro_micro 16 (GPIO_ACTIVE_LOW | GPIO_PULL_UP)>
            , <&pro_micro 4 (GPIO_ACTIVE_LOW | GPIO_PULL_UP)>
            , <&pro_micro 20 (GPIO_ACTIVE_LOW | GPIO_PULL_UP)>
            , <&pro_micro 18 (GPIO_ACTIVE_LOW | GPIO_PULL_UP)>
            , <&pro_micro 10 (GPIO_ACTIVE_LOW | GPIO_PULL_UP)>
            , <&pro_micro 5 (GPIO_ACTIVE_LOW | GPIO_PULL_UP)>
            , <&pro_micro 14 (GPIO_ACTIVE_LOW | GPIO_PULL_UP)>
            , <&pro_micro 15 (GPIO_ACTIVE_LOW | GPIO_PULL_UP)>
            , <&pro_micro 6 (GPIO_ACTIVE_LOW | GPIO_PULL_UP)>
            , <&pro_micro 7 (GPIO_ACTIVE_LOW | GPIO_PULL_UP)>
            , <&pro_micro 9 (GPIO_ACTIVE_LOW | GPIO_PULL_UP)>
            , <&pro_micro 8 (GPIO_ACTIVE_LOW | GPIO_PULL_UP)>
            ;

};


&default_transform { // Offset of 14 because the left side has 14 columns
    col-offset = <14>;
};
