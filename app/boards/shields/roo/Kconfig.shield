## app/boards/shields/roo/Kconfig.shield
```kconfig
config SHIELD_MY_KEYBOARD_LEFT
    def_bool $(shields_list_contains,roo_left)

config SHIELD_MY_KEYBOARD_RIGHT
    def_bool $(shields_list_contains,roo_right)
```
